## package/lldb/Config.in
```kconfig
config BR2_PACKAGE_LLDB_ARCH_SUPPORTS
	bool
	default y if BR2_i386
	default y if BR2_x86_64
	default y if BR2_aarch64
	default y if BR2_arm || BR2_armeb

config BR2_PACKAGE_LLDB_TARGET_ARCH
	string
	default "AArch64" if BR2_aarch64
	default "ARM" if BR2_arm || BR2_armeb
	default "X86" if BR2_i386 || BR2_x86_64

config BR2_PACKAGE_LLDB
	bool "lldb"
	depends on BR2_PACKAGE_LLDB_ARCH_SUPPORTS
	depends on BR2_TOOLCHAIN_GCC_AT_LEAST_4_8
	depends on BR2_TOOLCHAIN_HAS_THREADS
	depends on BR2_INSTALL_LIBSTDCPP
	depends on !BR2_TOOLCHAIN_HAS_GCC_BUG_64735 # std::shared_future
	depends on !BR2_STATIC_LIBS
	depends on BR2_USE_WCHAR # std::wstring
	help
	  The LLDB is a debugger built from the LLVM project

	  http://lldb.llvm.org

if BR2_PACKAGE_LLDB
choice
        prompt "where to get the source"
        default BR2_PACKAGE_LLDB_CUSTOM_TARBALL
        help
          Select how to get the latest donetcore runtime source
          one is to clone from the github repo
          another is to download fom the github release tarball(default)

config BR2_PACKAGE_LLDB_CUSTOM_TARBALL
        bool "Release Tarball"
        help
          This option allows you to specify a URL pointing to the specified
          release source tarball for dotnetruntime.

config BR2_PACKAGE_LLDB_CUSTOM_GIT
        bool "Git Repo"
        help
          This option is to get the dotnetruntime source
          code from the Git repo.

endchoice

config BR2_PACKAGE_LLDB_CUSTOM_TARBALL_LOCATION
        string "URL of Tarball"
        default "https://github.com/llvm/llvm-project/archive/refs/tags/llvmorg-15.0.5.tar.gz"
        depends on BR2_PACKAGE_LLDB_CUSTOM_TARBALL

if BR2_PACKAGE_LLDB_CUSTOM_GIT

config BR2_PACKAGE_LLDB_CUSTOM_REPO_URL
        string "URL of Git Repo"
        default "https://github.com/llvm/llvm-project.git"

config BR2_PACKAGE_LLDB_CUSTOM_REPO_VERSION
        string "Custom repo version"
        default "origin/main"
        help
          Revision to use in the typical format used by
          Git/Mercurial/Subversion E.G. a sha id, a tag, branch, ..

endif
endif

comment "lldb needs a toolchain w/ wchar, threads, C++, gcc >= 4.8, dynamic library"
	depends on BR2_PACKAGE_LLDB_ARCH_SUPPORTS
	depends on !BR2_TOOLCHAIN_HAS_THREADS || !BR2_INSTALL_LIBSTDCPP || \
		!BR2_TOOLCHAIN_GCC_AT_LEAST_4_8 \
		|| BR2_STATIC_LIBS || !BR2_USE_WCHAR

comment "lldb needs a toolchain not affected by GCC bug 64735"
	depends on BR2_PACKAGE_LLDB_ARCH_SUPPORTS
	depends on BR2_TOOLCHAIN_HAS_GCC_BUG_64735
```

## savedconfigs/arm/br2.defconfig
```kconfig
BR2_arm=y
BR2_cortex_a9=y
BR2_ARM_ENABLE_NEON=y
BR2_ARM_ENABLE_VFP=y
BR2_ENABLE_DEBUG=y
# BR2_STRIP_strip is not set
BR2_TOOLCHAIN_BUILDROOT_GLIBC=y
BR2_BINUTILS_VERSION_2_36_X=y
BR2_GCC_VERSION_10_X=y
BR2_TOOLCHAIN_BUILDROOT_CXX=y
BR2_PACKAGE_HOST_GDB=y
BR2_PACKAGE_HOST_GDB_TUI=y
BR2_PACKAGE_HOST_GDB_PYTHON3=y
BR2_PACKAGE_HOST_GDB_SIM=y
BR2_GDB_VERSION_10=y
BR2_TARGET_GENERIC_GETTY_PORT="ttyAMA0"
BR2_SYSTEM_DHCP="eth0"
BR2_SYSTEM_ENABLE_NLS=y
BR2_TARGET_TZ_INFO=y
BR2_ROOTFS_OVERLAY="~/4dotnet/overlay"
BR2_ROOTFS_POST_BUILD_SCRIPT="~/4dotnet/scripts/post-build.sh"
BR2_ROOTFS_POST_IMAGE_SCRIPT="board/qemu/post-image.sh"
BR2_ROOTFS_POST_SCRIPT_ARGS="$(BR2_DEFCONFIG)"
BR2_LINUX_KERNEL=y
BR2_LINUX_KERNEL_USE_CUSTOM_CONFIG=y
BR2_LINUX_KERNEL_CUSTOM_CONFIG_FILE="~/4dotnet/savedconfigs/arm/linux.defconfig"
BR2_PACKAGE_BUSYBOX_SHOW_OTHERS=y
BR2_PACKAGE_BUSYBOX_INDIVIDUAL_BINARIES=y
BR2_PACKAGE_GDB=y
BR2_PACKAGE_GDB_DEBUGGER=y
BR2_PACKAGE_GDB_TUI=y
BR2_PACKAGE_CA_CERTIFICATES=y
BR2_PACKAGE_LIBKRB5=y
BR2_PACKAGE_LIBUNWIND=y
BR2_PACKAGE_LTTNG_LIBUST=y
BR2_PACKAGE_ICU=y
BR2_PACKAGE_NTP=y
BR2_PACKAGE_OPENSSH=y
BR2_TARGET_ROOTFS_EXT2=y
BR2_TARGET_ROOTFS_EXT2_SIZE="8192M"
BR2_PACKAGE_HOST_PYTHON3=y
BR2_PACKAGE_HOST_QEMU=y
BR2_PACKAGE_HOST_QEMU_SYSTEM_MODE=y
BR2_PACKAGE_HOST_QEMU_VIRTFS=y
BR2_PACKAGE_LLDB=y
BR2_PACKAGE_CLRMD=y
BR2_PACKAGE_DOTNETRUNTIME=y
BR2_PACKAGE_DIAGNOSTICS=y
BR2_PACKAGE_DOTNETHELLO=y
```

## savedconfigs/riscv32/br2.defconfig
```kconfig
BR2_riscv=y
BR2_RISCV_32=y
BR2_ENABLE_DEBUG=y
# BR2_STRIP_strip is not set
BR2_TOOLCHAIN_BUILDROOT_CXX=y
BR2_PACKAGE_HOST_GDB=y
BR2_PACKAGE_HOST_GDB_TUI=y
BR2_PACKAGE_HOST_GDB_PYTHON3=y
BR2_PACKAGE_HOST_GDB_SIM=y
BR2_SYSTEM_DHCP="eth0"
BR2_SYSTEM_ENABLE_NLS=y
BR2_TARGET_TZ_INFO=y
BR2_ROOTFS_OVERLAY="~/4dotnet/overlay"
BR2_ROOTFS_POST_BUILD_SCRIPT="~/4dotnet/scripts/post-build.sh"
BR2_ROOTFS_POST_IMAGE_SCRIPT="board/qemu/post-image.sh"
BR2_ROOTFS_POST_SCRIPT_ARGS="$(BR2_DEFCONFIG)"
BR2_LINUX_KERNEL=y
BR2_LINUX_KERNEL_USE_CUSTOM_CONFIG=y
BR2_LINUX_KERNEL_CUSTOM_CONFIG_FILE="~/4dotnet/savedconfigs/riscv32/linux.defconfig"
BR2_PACKAGE_BUSYBOX_SHOW_OTHERS=y
BR2_PACKAGE_UNZIP=y
BR2_PACKAGE_GDB=y
BR2_PACKAGE_GDB_SERVER=y
BR2_PACKAGE_GDB_DEBUGGER=y
BR2_PACKAGE_GDB_TUI=y
BR2_PACKAGE_BINUTILS=y
BR2_PACKAGE_BINUTILS_TARGET=y
BR2_PACKAGE_CA_CERTIFICATES=y
BR2_PACKAGE_LIBKRB5=y
BR2_PACKAGE_LTTNG_LIBUST=y
BR2_PACKAGE_ICU=y
BR2_PACKAGE_NTP=y
BR2_PACKAGE_OPENSSH=y
BR2_TARGET_ROOTFS_EXT2=y
BR2_TARGET_ROOTFS_EXT2_SIZE="4096M"
BR2_TARGET_OPENSBI=y
BR2_TARGET_OPENSBI_PLAT="generic"
BR2_PACKAGE_HOST_QEMU=y
BR2_PACKAGE_HOST_QEMU_SYSTEM_MODE=y
BR2_PACKAGE_HOST_QEMU_VIRTFS=y
BR2_PACKAGE_HELLO=y
BR2_PACKAGE_LLDB=y
```

## savedconfigs/riscv64/br2.defconfig
```kconfig
BR2_riscv=y
BR2_ENABLE_DEBUG=y
# BR2_STRIP_strip is not set
BR2_TOOLCHAIN_BUILDROOT_GLIBC=y
BR2_BINUTILS_VERSION_2_38_X=y
BR2_GCC_VERSION_11_X=y
BR2_TOOLCHAIN_BUILDROOT_CXX=y
BR2_PACKAGE_HOST_GDB=y
BR2_PACKAGE_HOST_GDB_TUI=y
BR2_PACKAGE_HOST_GDB_PYTHON3=y
BR2_PACKAGE_HOST_GDB_SIM=y
BR2_GDB_VERSION_11=y
BR2_SYSTEM_DHCP="eth0"
BR2_SYSTEM_ENABLE_NLS=y
BR2_TARGET_TZ_INFO=y
BR2_ROOTFS_OVERLAY="~/4dotnet/overlay"
BR2_ROOTFS_POST_BUILD_SCRIPT="~/4dotnet/scripts/post-build.sh"
BR2_ROOTFS_POST_IMAGE_SCRIPT="board/qemu/post-image.sh"
BR2_ROOTFS_POST_SCRIPT_ARGS="$(BR2_DEFCONFIG)"
BR2_LINUX_KERNEL=y
BR2_LINUX_KERNEL_CUSTOM_VERSION=y
BR2_LINUX_KERNEL_CUSTOM_VERSION_VALUE="5.17.5"
BR2_LINUX_KERNEL_USE_ARCH_DEFAULT_CONFIG=y
BR2_PACKAGE_BUSYBOX_SHOW_OTHERS=y
BR2_PACKAGE_GDB=y
BR2_PACKAGE_GDB_SERVER=y
BR2_PACKAGE_GDB_DEBUGGER=y
BR2_PACKAGE_GDB_TUI=y
BR2_PACKAGE_BINUTILS=y
BR2_PACKAGE_BINUTILS_TARGET=y
BR2_PACKAGE_CA_CERTIFICATES=y
BR2_PACKAGE_LIBKRB5=y
BR2_PACKAGE_LTTNG_LIBUST=y
BR2_PACKAGE_ICU=y
BR2_PACKAGE_NTP=y
BR2_PACKAGE_OPENSSH=y
BR2_TARGET_ROOTFS_EXT2=y
BR2_TARGET_ROOTFS_EXT2_SIZE="16384M"
BR2_TARGET_OPENSBI=y
BR2_TARGET_OPENSBI_PLAT="generic"
BR2_PACKAGE_HOST_QEMU=y
BR2_PACKAGE_HOST_QEMU_SYSTEM_MODE=y
BR2_PACKAGE_HOST_QEMU_VIRTFS=y
BR2_PACKAGE_HELLO=y
BR2_PACKAGE_LLDB=y
BR2_PACKAGE_DOTNETRUNTIME=y
```
