## Config.in
```kconfig
source "$BR2_EXTERNAL_4dotnet_PATH/package/hello/Config.in"
source "$BR2_EXTERNAL_4dotnet_PATH/package/lldb/Config.in"
source "$BR2_EXTERNAL_4dotnet_PATH/package/dotnetcore/diagnostics/Config.in"
source "$BR2_EXTERNAL_4dotnet_PATH/package/dotnetcore/runtime/Config.in"
source "$BR2_EXTERNAL_4dotnet_PATH/package/dotnetsdk/Config.in"
```

## package/dotnetcore/clrmd/Config.in
```kconfig
config BR2_PACKAGE_CLRMD_ARCH_SUPPORTS
        bool
	default y if BR2_i386
	default y if BR2_x86_64
        default y if BR2_aarch64
        default y if BR2_arm || BR2_armeb
        default y if BR2_riscv || BR2_RISCV_32
        default y if BR2_RISCV_64

config BR2_PACKAGE_CLRMD_TARGET_ARCH
        string
        default "ARM64" if BR2_aarch64
        default "ARM" if BR2_arm || BR2_armeb
	default "X86" if BR2_i386 || BR2_x86_64
        default "RISCV32" if BR2_riscv || BR2_RISCV_32
        default "RISCV64" if BR2_RISCV_64

config BR2_PACKAGE_CLRMD
	bool "clrmd"
	depends on BR2_PACKAGE_CLRMD_ARCH_SUPPORTS
	depends on BR2_PACKAGE_LLDB
        depends on BR2_PACKAGE_DOTNETRUNTIME
	help
	  ClrMD is a process and crash dump introspection library

	  https://github.com/microsoft/clrmd.git

if BR2_PACKAGE_CLRMD
choice
        prompt "where to get the source"
        default BR2_PACKAGE_CLRMD_CUSTOM_GIT
        help
          Select how to get the latest ClrMD source
          one is to clone from the github repo
          another is to download fom the github release tarball(default)

config BR2_PACKAGE_CLRMD_CUSTOM_TARBALL
        bool "Release Tarball"
        help
          This option allows you to specify a URL pointing to the specified
          release source tarball for ClrMD.

config BR2_PACKAGE_CLRMD_CUSTOM_GIT
        bool "Git Repo"
        help
          This option is to get the ClrMD source
          code from the Git repo.

endchoice

config BR2_PACKAGE_CLRMD_CUSTOM_TARBALL_LOCATION
        string "URL of Tarball"
        default "https://github.com/microsoft/clrmd/archive/refs/tags/0.9.170626.1.tar.gz"
        depends on BR2_PACKAGE_CLRMD_CUSTOM_TARBALL

if BR2_PACKAGE_CLRMD_CUSTOM_GIT

config BR2_PACKAGE_CLRMD_CUSTOM_REPO_URL
        string "URL of Git Repo"
        default "git://github.com/microsoft/clrmd.git"

config BR2_PACKAGE_CLRMD_CUSTOM_REPO_VERSION
        string "Custom repo version"
        default "origin/master"
        help
          Revision to use in the typical format used by
          Git/Mercurial/Subversion E.G. a sha id, a tag, branch, ..

endif
endif

comment "ClrMD needs lldb and dotnetruntime package" 
	depends on BR2_PACKAGE_CLRMD_ARCH_SUPPORTS
	depends on BR2_PACKAGE_LLDB
        depends on BR2_PACKAGE_DOTNETRUNTIME
```

## package/dotnetcore/diagnostics/Config.in
```kconfig
config BR2_PACKAGE_DIAGNOSTICS_ARCH_SUPPORTS
        bool
	default y if BR2_i386
	default y if BR2_x86_64
        default y if BR2_aarch64
        default y if BR2_arm || BR2_armeb

config BR2_PACKAGE_DIAGNOSTICS_TARGET_ARCH
        string
        default "ARM64" if BR2_aarch64
        default "ARM" if BR2_arm || BR2_armeb
	default "X86" if BR2_i386 || BR2_x86_64

config BR2_PACKAGE_DIAGNOSTICS
	bool "diagnostics"
	depends on BR2_PACKAGE_DIAGNOSTICS_ARCH_SUPPORTS
	depends on BR2_PACKAGE_LLDB
	depends on BR2_PACKAGE_CLRMD
        depends on BR2_PACKAGE_DOTNETRUNTIME
	help
	  diagnostics is .net core runtime diagnostics package

	  https://github.com/dotnet/diagnostics

if BR2_PACKAGE_DIAGNOSTICS
choice
        prompt "where to get the source"
        default BR2_PACKAGE_DIAGNOSTICS_CUSTOM_GIT 
        help
          Select how to get the latest diagnostics source
          one is to clone from the github repo
          another is to download fom the github release tarball(default)

config BR2_PACKAGE_DIAGNOSTICS_CUSTOM_TARBALL
        bool "Release Tarball"
        help
          This option allows you to specify a URL pointing to the specified
          release source tarball for diagnostics.

config BR2_PACKAGE_DIAGNOSTICS_CUSTOM_GIT
        bool "Git Repo"
        help
          This option is to get the diagnostics source
          code from the Git repo.

endchoice

config BR2_PACKAGE_DIAGNOSTICS_CUSTOM_TARBALL_LOCATION
        string "URL of Tarball"
        default "https://github.com/dotnet/diagnostics/archive/refs/tags/v5.0.227602.tar.gz"
        depends on BR2_PACKAGE_DIAGNOSTICS_CUSTOM_TARBALL

if BR2_PACKAGE_DIAGNOSTICS_CUSTOM_GIT

config BR2_PACKAGE_DIAGNOSTICS_CUSTOM_REPO_URL
        string "URL of Git Repo"
        default "https://github.com/dotnet/diagnostics.git"

config BR2_PACKAGE_DIAGNOSTICS_CUSTOM_REPO_VERSION
        string "Custom repo version"
        default "origin/main"
        help
          Revision to use in the typical format used by
          Git/Mercurial/Subversion E.G. a sha id, a tag, branch, ..

endif
endif

comment "diagnostics needs lldb,ClrMD and dotnetruntime package" 
	depends on BR2_PACKAGE_DIAGNOSTICS_ARCH_SUPPORTS
	depends on BR2_PACKAGE_LLDB
	depends on BR2_PACKAGE_CLRMD
        depends on BR2_PACKAGE_DOTNETRUNTIME
```

## package/dotnetcore/dotnet-monitor/Config.in
```kconfig
config BR2_PACKAGE_DOTNET-MONITOR_ARCH_SUPPORTS
        bool
        default y if BR2_aarch64

config BR2_PACKAGE_DOTNET-MONITOR_TARGET_ARCH
        string
        default "ARM64" if BR2_aarch64

config BR2_PACKAGE_DOTNET-MONITOR
	bool "dotnet-monitor"
	depends on BR2_PACKAGE_DOTNET-MONITOR_ARCH_SUPPORTS
        depends on BR2_PACKAGE_DOTNETRUNTIME
	help
          dotnet-monitor is an tool that makes it easier to get access to diagnostics information in a dotnet process.
	  https://github.com/dotnet/dotnet-monitor

if BR2_PACKAGE_DOTNET-MONITOR
choice
        prompt "where to get the source"
        default BR2_PACKAGE_DOTNET-MONITOR_CUSTOM_GIT
        help
          Select how to get the latest dotnet-monitor source
          one is to clone from the github repo
          another is to download fom the github release tarball(default)

config BR2_PACKAGE_DOTNET-MONITOR_CUSTOM_TARBALL
        bool "Release Tarball"
        help
          This option allows you to specify a URL pointing to the specified
          release source tarball for symstore.

config BR2_PACKAGE_DOTNET-MONITOR_CUSTOM_GIT
        bool "Git Repo"
        help
          This option is to get the dotnet-monitor source
          code from the Git repo.

endchoice

config BR2_PACKAGE_DOTNET-MONITOR_CUSTOM_TARBALL_LOCATION
        string "URL of Tarball"
        default "https://github.com/dotnet/dotnet-monitor/archive/refs/tags/v5.0.0-preview.7.21425.3.tar.gz"
        depends on BR2_PACKAGE_DOTNET-MONITOR_CUSTOM_TARBALL

if BR2_PACKAGE_DOTNET-MONITOR_CUSTOM_GIT

config BR2_PACKAGE_DOTNET-MONITOR_CUSTOM_REPO_URL
        string "URL of Git Repo"
        default "git://github.com/dotnet/dotnet-monitor.git"

config BR2_PACKAGE_DOTNET-MONITOR_CUSTOM_REPO_VERSION
        string "Custom repo version"
        default "origin/main"
        help
          Revision to use in the typical format used by
          Git/Mercurial/Subversion E.G. a sha id, a tag, branch, ..

endif
endif

comment "dotnet-monitor needs dotnetruntime package" 
	depends on BR2_PACKAGE_DOTNET-MONITOR_ARCH_SUPPORTS
        depends on BR2_PACKAGE_DOTNETRUNTIME
```

## package/dotnetcore/dotnetruntime/Config.in
```kconfig
config BR2_PACKAGE_DOTNETRUNTIME_ARCH_SUPPORTS
        bool
	default y if BR2_i386
	default y if BR2_x86_64
        default y if BR2_aarch64
        default y if BR2_arm || BR2_armeb
        default y if BR2_riscv && BR2_RISCV_32
        default y if BR2_riscv && BR2_RISCV_64

config BR2_PACKAGE_DOTNETRUNTIME_TARGET_ARCH
        string
        default "ARM64" if BR2_aarch64
        default "ARM" if BR2_arm || BR2_armeb
	default "X86" if BR2_i386 || BR2_x86_64
        default "RISCV32" if BR2_riscv && BR2_RISCV_32
        default "RISCV64" if BR2_riscv && BR2_RISCV_64

config BR2_PACKAGE_DOTNETRUNTIME
	bool "dotnetruntime"
	depends on BR2_PACKAGE_DOTNETRUNTIME_ARCH_SUPPORTS
	depends on BR2_PACKAGE_LLDB
	help
	  dotnetruntime is .net core runtime package

	  https://github.com/dotnet/runtime

if BR2_PACKAGE_DOTNETRUNTIME
choice
	prompt "where to get the source"
	default BR2_PACKAGE_DOTNETRUNTIME_CUSTOM_GIT
	help
	  Select how to get the latest donetcore runtime source
	  one is to clone from the github repo 
	  another is to download fom the github release tarball(default)

config BR2_PACKAGE_DOTNETRUNTIME_CUSTOM_TARBALL
        bool "Release Tarball"
        help
          This option allows you to specify a URL pointing to the specified
          release source tarball for dotnetruntime. 

config BR2_PACKAGE_DOTNETRUNTIME_CUSTOM_GIT
        bool "Git Repo"
        help
          This option is to get the dotnetruntime source
          code from the Git repo.

config BR2_PACKAGE_DOTNETRUNTIME_CUSTOM_LOCAL
        bool "Local Runtime"
        help
          This option is to get the dotnetruntime source 
          code from from the local folder

endchoice

config BR2_PACKAGE_DOTNETRUNTIME_CUSTOM_TARBALL_LOCATION
        string "URL of Tarball"
	default "https://github.com/dotnet/runtime/archive/refs/tags/v8.0.0.tar.gz"
        depends on BR2_PACKAGE_DOTNETRUNTIME_CUSTOM_TARBALL

if BR2_PACKAGE_DOTNETRUNTIME_CUSTOM_GIT

config BR2_PACKAGE_DOTNETRUNTIME_CUSTOM_REPO_URL
        string "URL of Git Repo"
	default "https://github.com/oldzhu/runtime.git"

config BR2_PACKAGE_DOTNETRUNTIME_CUSTOM_REPO_VERSION
        string "Custom repo version"
	default "origin/risc-v"
        help
          Revision to use in the typical format used by
          Git/Mercurial/Subversion E.G. a sha id, a tag, branch, ..

endif

if BR2_PACKAGE_DOTNETRUNTIME_CUSTOM_LOCAL
config BR2_PACKAGE_DOTNETRUNTIME_CUSTOM_LOCAL_FOLDER
        string "The local folder of Runtime"
        default "~/my_runtime"
        help
          The local folder to the runtime source code
endif

endif

comment "dotnetruntime needs lldb package" 
	depends on BR2_PACKAGE_DOTNETRUNTIME_ARCH_SUPPORTS
	depends on BR2_PACKAGE_LLDB 
```

## package/dotnetcore/runtime/Config.in
```kconfig
config BR2_PACKAGE_DOTNETRUNTIME_ARCH_SUPPORTS
        bool
        default y if BR2_aarch64
        default y if BR2_arm || BR2_armeb

config BR2_PACKAGE_DOTNETRUNTIME_TARGET_ARCH
        string
        default "ARM64" if BR2_aarch64
        default "ARM" if BR2_arm || BR2_armeb

config BR2_PACKAGE_DOTNETRUNTIME
	bool "dotnetruntime"
	depends on BR2_PACKAGE_DOTNETRUNTIME_ARCH_SUPPORTS
	depends on BR2_PACKAGE_LLDB
	help
	  dotnetruntime is .net core runtime package

	  https://github.com/dotnet/runtime

comment "dotnetruntime needs lldb package" 
	depends on BR2_PACKAGE_DOTNETRUNTIME_ARCH_SUPPORTS
	depends on BR2_PACKAGE_LLDB 
```

## package/dotnetcore/symstore/Config.in
```kconfig
config BR2_PACKAGE_SYMSTORE_ARCH_SUPPORTS
        bool
	default y if BR2_i386
	default y if BR2_x86_64
        default y if BR2_aarch64
        default y if BR2_arm || BR2_armeb

config BR2_PACKAGE_SYMSTORE_TARGET_ARCH
        string
        default "ARM64" if BR2_aarch64
        default "ARM" if BR2_arm || BR2_armeb
	default "X86" if BR2_i386 || BR2_x86_64

config BR2_PACKAGE_SYMSTORE
	bool "symstore"
	depends on BR2_PACKAGE_SYMSTORE_ARCH_SUPPORTS
	depends on BR2_PACKAGE_LLDB
        depends on BR2_PACKAGE_DOTNETRUNTIME
	help
          Implements API for retrieval of symbols and other debug artifacts from symbol store
	  https://github.com/dotnet/symstore

if BR2_PACKAGE_SYMSTORE
choice
        prompt "where to get the source"
        default BR2_PACKAGE_SYMSTORE_CUSTOM_GIT
        help
          Select how to get the latest symstore source
          one is to clone from the github repo
          another is to download fom the github release tarball(default)

config BR2_PACKAGE_SYMSTORE_CUSTOM_TARBALL
        bool "Release Tarball"
        help
          This option allows you to specify a URL pointing to the specified
          release source tarball for symstore.

config BR2_PACKAGE_SYMSTORE_CUSTOM_GIT
        bool "Git Repo"
        help
          This option is to get the symstore source
          code from the Git repo.

endchoice

config BR2_PACKAGE_SYMSTORE_CUSTOM_TARBALL_LOCATION
        string "URL of Tarball"
        default "https://github.com/dotnet/symstore/archive/refs/tags/EmbedIndex.tar.gz"
        depends on BR2_PACKAGE_SYMSTORE_CUSTOM_TARBALL

if BR2_PACKAGE_SYMSTORE_CUSTOM_GIT

config BR2_PACKAGE_SYMSTORE_CUSTOM_REPO_URL
        string "URL of Git Repo"
        default "git://github.com/dotnet/symstore.git"

config BR2_PACKAGE_SYMSTORE_CUSTOM_REPO_VERSION
        string "Custom repo version"
        default "origin/main"
        help
          Revision to use in the typical format used by
          Git/Mercurial/Subversion E.G. a sha id, a tag, branch, ..

endif
endif

comment "symstore needs lldb and dotnetruntime package" 
	depends on BR2_PACKAGE_SYMSTORE_ARCH_SUPPORTS
	depends on BR2_PACKAGE_LLDB
        depends on BR2_PACKAGE_DOTNETRUNTIME
```

## package/dotnethello/Config.in
```kconfig
config BR2_PACKAGE_DOTNETHELLO_ARCH_SUPPORTS
        bool
	default y if BR2_i386
	default y if BR2_x86_64
        default y if BR2_aarch64
        default y if BR2_arm || BR2_armeb
	default y if BR2_riscv || BR2_RISCV_32
	default y if BR2_RISCV_64

config BR2_PACKAGE_DOTNETHELLO_TARGET_ARCH
        string
        default "ARM64" if BR2_aarch64
        default "ARM" if BR2_arm || BR2_armeb
	default "X86" if BR2_i386 || BR2_x86_64
	default "RISCV32" if BR2_riscv || BR2_RISCV_32
	default "RISCV64" if BR2_RISCV_64

config BR2_PACKAGE_DOTNETHELLO
	bool "dotnethello"
	depends on BR2_PACKAGE_DOTNETHELLO_ARCH_SUPPORTS
	depends on BR2_PACKAGE_LLDB
	depends on BR2_PACKAGE_CLRMD
	depends on BR2_PACKAGE_DOTNETRUNTIME
	depends on BR2_PACKAGE_DIAGNOSTICS
	help
          dotnet core Hello world package.

          http://example.com

comment "dotnet core hello world package need lldb,clrmd,dotnetruntime and diagnostics package"
	depends on BR2_PACKAGE_DOTNETHELLO_ARCH_SUPPORTS
	depends on BR2_PACKAGE_LLDB
	depends on BR2_PACKAGE_CLRMD
	depends on BR2_PACKAGE_DOTNETRUNTIME	
	depends on BR2_PACKAGE_DIAGNOSTICS
```

## package/dotnetsdk/Config.in
```kconfig
config BR2_PACKAGE_DOTNETSDK_ARCH_SUPPORTS
	bool
	default y if BR2_aarch64
#	default y if BR2_arm || BR2_armeb

config BR2_PACKAGE_DOTNETSDK_TARGET_ARCH
	string
	default "AArch64" if BR2_aarch64
#	default "ARM" if BR2_arm || BR2_armeb

config BR2_PACKAGE_DOTNETSDK
	bool "dotnetsdk"
	depends on BR2_PACKAGE_DOTNETSDK_ARCH_SUPPORTS
#	depends on BR2_PACKAGE_LLDB
	help
	  The DOTNETSDK is the .NET Core SDK zip package for arm64

	  https://github.com/dotnet/core-sdk
```

## package/hello/Config.in
```kconfig
config BR2_PACKAGE_HELLO
    bool "hello"
    help
        Hello world package.

        http://example.com
```
